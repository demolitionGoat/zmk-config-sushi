## boards/shields/sushi2/Kconfig.defconfig
```kconfig
if SHIELD_SUSHI2_LEFT

config ZMK_KEYBOARD_NAME
    default "sushi2"

config ZMK_SPLIT_ROLE_CENTRAL
    default y

endif # SHIELD_SUSHI2_LEFT

if SHIELD_SUSHI2_LEFT || SHIELD_SUSHI2_RIGHT

config ZMK_SPLIT
    default y

config ZMK_BLE
	default y

endif # SHIELD_SUSHI2_LEFT || SHIELD_SUSHI2_RIGHT
```

## boards/shields/sushi2/Kconfig.shield
```kconfig
config SHIELD_SUSHI2_LEFT
    def_bool $(shields_list_contains,sushi2_left)

config SHIELD_SUSHI2_RIGHT
    def_bool $(shields_list_contains,sushi2_right)
```
