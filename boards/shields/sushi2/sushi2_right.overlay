#include "sushi2.dtsi"

&default_transform {
    // Set this to the number of columns on the left side.
    col-offset = <6>;
};

&kscanMatrix {
    // Columns flipped
    col-gpios
        = <&pro_micro 18 GPIO_ACTIVE_HIGH>
        , <&pro_micro 15 GPIO_ACTIVE_HIGH>
        , <&pro_micro 14 GPIO_ACTIVE_HIGH>
        , <&pro_micro 16 GPIO_ACTIVE_HIGH>
        , <&pro_micro 10 GPIO_ACTIVE_HIGH>
		, <&pro_micro 4  GPIO_ACTIVE_HIGH>
        ;
};

&right_encoder {
	status = "okay";
	steps = <40>;
};
